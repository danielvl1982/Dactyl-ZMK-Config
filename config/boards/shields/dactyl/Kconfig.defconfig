## config/boards/shields/dactyl/Kconfig.defconfig
```kconfig
if SHIELD_DACTYL_LEFT

config ZMK_KEYBOARD_NAME
    default "Dactyl 4x6"

config ZMK_SPLIT_ROLE_CENTRAL
    default y

endif

if SHIELD_DACTYL_LEFT || SHIELD_DACTYL_RIGHT

config ZMK_SPLIT
    default y

endif

# Bring-up shields: standalone USB keyboards, no split.
if SHIELD_DACTYL_LEFT_SOLO

config ZMK_KEYBOARD_NAME
    default "Dactyl 4x6 Left"

endif

if SHIELD_DACTYL_RIGHT_SOLO

config ZMK_KEYBOARD_NAME
    default "Dactyl 4x6 Right"

endif
```

## config/boards/shields/dactyl/Kconfig.shield
```kconfig
config SHIELD_DACTYL_LEFT
    def_bool $(shields_list_contains,dactyl_left)

config SHIELD_DACTYL_RIGHT
    def_bool $(shields_list_contains,dactyl_right)

config SHIELD_DACTYL4X6LH
    def_bool $(shields_list_contains,dactyl4x6lh)

config SHIELD_DACTYL4X6RH
    def_bool $(shields_list_contains,dactyl4x6rh)
```

## config/boards/shields/dactyl4x6lh/Kconfig.defconfig
```kconfig
if SHIELD_DACTYL4X6LH

config ZMK_KEYBOARD_NAME
    default "Dactyl 4x6 Left"

endif
```

## config/boards/shields/dactyl4x6rh/Kconfig.defconfig
```kconfig
if SHIELD_DACTYL4X6RH

config ZMK_KEYBOARD_NAME
    default "Dactyl 4x6 R"

endif
```
